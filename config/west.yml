## config/west.yml
```yaml
manifest:
  remotes:
    - name: zmkfirmware
      url-base: https://github.com/zmkfirmware
    - name: petejohanson
      url-base: https://github.com/petejohanson
  projects:
    - name: zmk
      remote:  petejohanson
      revision: shields/kyria_rev2
      import: app/west.yml
  self:
    path: config
```
